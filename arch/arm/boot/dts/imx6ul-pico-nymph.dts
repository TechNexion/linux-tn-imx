/*
 * Copyright 2018 Technexion Ltd.
 *
 * Author: Tapani Utriainen <tapani@technexion.com>
 *	   Richard Hu <richard.hu@technexion.com>
 *
 * This program is free software; you can redistribute it and/or modify
 * it under the terms of the GNU General Public License version 2 as
 * published by the Free Software Foundation.
 *
 */
/dts-v1/;

#include "imx6ul.dtsi"
#include "imx6ul-pico.dtsi"
#include "baseboard_pico_nymph.dtsi"

/ {
	model = "TechNexion PICO-IMX6UL and NYMPH baseboard";
	compatible = "fsl,pico-imx6ul", "fsl,imx6ul";
};

