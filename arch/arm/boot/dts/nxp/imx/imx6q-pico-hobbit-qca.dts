/*
 * Copyright 2016,2017,2018 Technexion Ltd.
 *
 * Author: Wig Cheng <wig.cheng@technexion.com>
 *         Richard Hu <richard.hu@technexion.com>
 *         Tapani Utriainen <tapani@technexion.com>
 *
 * This program is free software; you can redistribute it and/or modify
 * it under the terms of the GNU General Public License version 2 as
 * published by the Free Software Foundation.
 *
 */
/dts-v1/;

#include "imx6q.dtsi"
#include "imx6qdl-pico-qca.dtsi"
#include "baseboard_pico_hobbit.dtsi"
/ {
	model = "TechNexion PICO-IMX6 Quad with QCA WLAN module and HOBBIT baseboard";
	compatible = "fsl,pico-imx6q", "fsl,imx6q";
};

&ldb {
	lvds-channel@0 {
		crtc = "ipu2-di0";
	};
};

&sata {
	status = "okay";
};
