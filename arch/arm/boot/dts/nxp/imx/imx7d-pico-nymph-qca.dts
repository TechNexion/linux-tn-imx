/*
 * Copyright 2018 Technexion Ltd.
 *
 * Author: Tapani Utriainen <tapani@technexion.com>
 *	   Richard Hu <richard.hu@technexion.com>
 *
 * This program is free software; you can redistribute it and/or modify
 * it under the terms of the GNU General Public License version 2 as
 * published by the Free Software Foundation.
 *
 */
/dts-v1/;

#include "imx7d.dtsi"
#include "imx7d-pico-qca.dtsi"
#include "baseboard_pico_nymph.dtsi"
/ {
	model = "TechNexion PICO-IMX7D with QCA WLAN module and NYMPH baseboard";
	compatible = "fsl,pico-imx7d", "fsl,imx7d";
};
