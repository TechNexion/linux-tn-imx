/dts-v1/;
/plugin/;

#include <dt-bindings/gpio/gpio.h>
#include <dt-bindings/pinctrl/pins-imx8mm.h>

/ {
	fragment@0 {
		target = <&i2c2>;
		__overlay__ {
			#address-cells = <1>;
			#size-cells = <0>;
			status = "okay";
			pn547: pn547@2a {
				compatible = "nxp,pn547";
				reg = <0x2a>;
				pinctrl-0 = <&pinctrl_ntag>;
				clock-frequency = <100000>;
				interrupt-gpios = <&gpio1 15 0>;
				enable-gpios = <&pca9555_1 9 0>;
				status = "okay";
			};
		};
	};

	fragment@1 {
		target = <&pwm4>;
		__overlay__ {
			status = "disabled";
		};
	};
};
