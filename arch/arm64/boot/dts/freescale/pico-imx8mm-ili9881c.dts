/*
 * Copyright 2018 Technexion Ltd.
 * Copyright 2018 NXP
 *
 * Author: Richard Hu <richard.hu@technexion.com>
 *
 * This program is free software; you can redistribute it and/or
 * modify it under the terms of the GNU General Public License
 * as published by the Free Software Foundation; either version 2
 * of the License, or (at your option) any later version.
 *
 * This program is distributed in the hope that it will be useful,
 * but WITHOUT ANY WARRANTY; without even the implied warranty of
 * MERCHANTABILITY or FITNESS FOR A PARTICULAR PURPOSE.  See the
 * GNU General Public License for more details.
 */

#include "pico-imx8mm.dts"

/ {
	backlight_mipi {
		status = "okay";
	};
};

&mipi_dsi {
	status = "okay";

	panel@0 {
		compatible = "bananapi,lhr050h41", "ilitek,ili9881c";
		pinctrl-0 = <&pinctrl_mipi_dsi_rst>;
		reset-gpio = <&gpio3 9 GPIO_ACTIVE_LOW>;
		reg = <0>;
		dsi-lanes = <4>;
		status = "okay";
	};
};